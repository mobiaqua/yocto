## meta-ti/conf/machine/beagle.conf
```bitbake
#@TYPE: Machine
#@NAME: AM5728 BeagleBoard X15, AM5729 BeagleBone AI
#@DESCRIPTION: Machine configuration for the BeagleBoard X15, BeagleBone AI

require conf/machine/include/arm/armv7a/tune-cortexa15.inc

require conf/machine/include/mesa-pvr.inc

KERNEL_IMAGETYPE = "uImage"

PREFERRED_PROVIDER_virtual/bootloader = "u-boot-beagleboard"

UBOOT_ENTRYPOINT = "0x80008000"
UBOOT_LOADADDRESS = "0x80008000"

PREFERRED_PROVIDER_virtual/kernel = "linux-ti"

PREFERRED_VERSION_linux-libc-headers = "6.6"
PREFERRED_VERSION_linux-ti = "6.6%"

SERIAL_CONSOLE = "115200 ttyS0"
SERIAL_CONSOLES = "115200;ttyS0"

EXTRA_IMAGEDEPENDS += "virtual/bootloader"

INSTALL_PKGS_RELEASE = "\
sgx-module-series5 ti-sgx-ddk-um sgx-module-init sgx-pvrsrvinit \
ti-gc320-driver ti-gc320-libs libdce libdce-firmware vpdma-fw brcmfmac-fw \
shairport-sync avahi-daemon \
"

INSTALL_PKGS_DEBUG = "\
mesa-pvr-dbg libdce-dbg libmmrpc-dbg sgx-pvrsrvinit-dbg \
"

DEPENDS_DEBUG_TOOLS = "gdb-cross-arm"
```

## meta-ti/conf/machine/beagle64.conf
```bitbake
#@TYPE: Machine
#@NAME: BeagleBone AI-64 (A72)
#@DESCRIPTION: Machine configuration for the BeagleBone AI-64 board (A72 core)

require conf/machine/include/ti-soc.inc
SOC_FAMILY:append = ":k3"
SOC_FAMILY:append = ":j721e"

require conf/machine/include/arm/arch-arm64.inc

require conf/machine/include/mesa-pvr.inc

BBMULTICONFIG += "beagle64r5"

KERNEL_IMAGETYPE = "Image"

PREFERRED_PROVIDER_virtual/kernel = "linux-ti64"
PREFERRED_PROVIDER_virtual/bootloader = "u-boot-beagle64"

PREFERRED_VERSION_linux-libc-headers = "6.6"
PREFERRED_VERSION_linux-ti = "6.1%"

SERIAL_CONSOLE = "115200 ttyS2"
SERIAL_CONSOLES = "115200;ttyS2"

UBOOT_MACHINE = "j721e_evm_a72_defconfig"

UBOOT_IMAGE = "u-boot.${UBOOT_SUFFIX}"

SPL_BINARY = "tispl.bin"
SPL_IMAGE = "tispl.bin"

DEVICETREE_FILE = "${@(d.getVar('KERNEL_DEVICETREE') or "").replace("ti/","")}"

UBOOT_EXTLINUX = "1"
UBOOT_EXTLINUX_ROOT = "root=/dev/mmcblk0p2"
UBOOT_EXTLINUX_LABELS = "default"
UBOOT_EXTLINUX_CONSOLE = "console=ttyS2,115200"
UBOOT_EXTLINUX_MENU_DESCRIPTION:default = "Linux Default"
UBOOT_EXTLINUX_KERNEL_IMAGE:default = "/zImage"
UBOOT_EXTLINUX_FDTDIR:default = "/"
UBOOT_EXTLINUX_KERNEL_ARGS:default = "rootwait earlyprintk"

EXTRA_IMAGEDEPENDS += "virtual/bootloader"

TFA_PLATFORM = "k3"
TFA_BOARD = "generic"

OPTEEMACHINE = "k3-j721e"

do_image_complete[mcdepends] += "mc::beagle64r5:virtual/bootloader:do_deploy"

INSTALL_PKGS_RELEASE = "\
ti-img-rogue-umlibs ti-img-rogue-umlibs-firmware sgx-module-init vxd-dec-fw \
"

INSTALL_PKGS_DEBUG = "\
mesa-pvr-dbg \
"

DEPENDS_DEBUG_TOOLS = "gdb-cross-aarch64"
```

## meta-ti/conf/machine/beagle64r5.conf
```bitbake
#@TYPE: Machine
#@NAME: BeagleBone AI-64 (R5F)
#@DESCRIPTION: Machine configuration for the BeagleBone AI-64 (R5F core)

require conf/machine/include/ti-soc.inc
SOC_FAMILY:append = ":k3r5"

# The closest of existing tunes for Cortex-R5F
DEFAULTTUNE = "armv7athf"
require conf/machine/include/arm/armv7a/tune-cortexa8.inc

TCLIBC = "baremetal"

PREFERRED_PROVIDER_virtual/kernel = "linux-dummy"
PREFERRED_PROVIDER_virtual/bootloader ?= "u-boot-beagle64"
PREFERRED_PROVIDER_u-boot ?= "u-boot-beagle64"

UBOOT_MACHINE = "j721e_evm_r5_defconfig"

UBOOT_SUFFIX = "bin"
UBOOT_BINARY = "tiboot3.${UBOOT_SUFFIX}"
UBOOT_IMAGE = "tiboot3.${UBOOT_SUFFIX}"

SPL_BINARY = ""

SYSFW_SOC = "j721e"
SYSFW_CONFIG = "evm"
SYSFW_SUFFIX = "gp"

PACKAGECONFIG:pn-u-boot-beagle64 = ""
```

## meta-ti/conf/machine/igep0030.conf
```bitbake
#@TYPE: Machine
#@NAME: IGEP machine
#@DESCRIPTION: Machine configuration for the IGEPv3.0 board

include conf/machine/include/arm/armv7a/tune-cortexa8.inc

require conf/machine/include/mesa-pvr.inc

PREFERRED_PROVIDER_virtual/kernel = "linux-ti"
PREFERRED_PROVIDER_virtual/bootloader = "x-loader-igep-mlo"

PREFERRED_VERSION_linux-libc-headers = "6.6"
PREFERRED_VERSION_linux-ti = "6.6%"

SERIAL_CONSOLE = "115200 ttyS2"
SERIAL_CONSOLES = "115200;ttyS2"

EXTRA_IMAGEDEPENDS += "virtual/bootloader"

INSTALL_PKGS_RELEASE = "\
"

INSTALL_PKGS_DEBUG = "\
"

DEPENDS_DEBUG_TOOLS = "gdb-cross-arm"
```

## meta-ti/conf/machine/panda.conf
```bitbake
#@TYPE: Machine
#@NAME: OMAP4430 PandaBoard, OMAP4460 Pandaboard ES
#@DESCRIPTION: Machine configuration for the PandaBoard, Pandaboard ES

require conf/machine/include/arm/armv7a/tune-cortexa9.inc

require conf/machine/include/mesa-pvr.inc

KERNEL_IMAGETYPE = "uImage"

PREFERRED_PROVIDER_virtual/bootloader = "u-boot-pandaboard"

UBOOT_ENTRYPOINT = "0x80008000"
UBOOT_LOADADDRESS = "0x80008000"

PREFERRED_PROVIDER_virtual/kernel = "linux-ti"

PREFERRED_VERSION_linux-libc-headers = "6.6"
PREFERRED_VERSION_linux-ti = "6.6%"

SERIAL_CONSOLE = "115200 ttyS2"

EXTRA_IMAGEDEPENDS += "virtual/bootloader"

INSTALL_PKGS_RELEASE = "\
sgx-module-series5 ti-sgx-ddk-um sgx-module-init sgx-pvrsrvinit \
libdce libdce-firmware wl127x-fw \
"

INSTALL_PKGS_DEBUG = "\
mesa-pvr-dbg libdce-dbg libmmrpc-dbg sgx-pvrsrvinit-dbg \
omapdrmtest omapdrmtest-dbg \
"

DEPENDS_DEBUG_TOOLS = "gdb-cross-arm"
```
