## meta-altera/conf/machine/de10nano.conf
```bitbake
#@TYPE: Machine
#@NAME: de10-nano
#@DESCRIPTION: Machine configuration for the Cyclone V DE10-Nano"

require conf/machine/include/arm/armv7a/tune-cortexa9.inc

KERNEL_IMAGETYPE ?= "zImage"

PREFERRED_PROVIDER_virtual/bootloader = "u-boot-de10nano"

PREFERRED_PROVIDER_virtual/kernel = "linux-altera"

PREFERRED_VERSION_linux-libc-headers = "6.6"
PREFERRED_VERSION_linux-altera = "6.6%"

DISTRO_FEATURES:remove = "wifi opengl"

UBOOT_EXTLINUX = "1"
UBOOT_EXTLINUX_ROOT = "root=/dev/mmcblk0p2"
UBOOT_EXTLINUX_LABELS = "default"
UBOOT_EXTLINUX_CONSOLE = "console=ttyS0,115200"
UBOOT_EXTLINUX_MENU_DESCRIPTION:default = "Linux Default"
UBOOT_EXTLINUX_KERNEL_IMAGE:default = "/zImage"
UBOOT_EXTLINUX_FDTDIR:default = "/"
UBOOT_EXTLINUX_KERNEL_ARGS:default = "rootwait"

SERIAL_CONSOLE = "115200 ttyS0"
SERIAL_CONSOLES = "115200;ttyS0"

EXTRA_IMAGEDEPENDS += "virtual/bootloader"

INSTALL_PKGS_RELEASE = "\
"

INSTALL_PKGS_DEBUG = "\
"

ROOTFS_POSTPROCESS_COMMAND += "mobiaqua_rootfs_clean_fw_dir ; "

DEPENDS_DEBUG_TOOLS = ""
```

## meta-bsp-car/conf/layer.conf
```bitbake
# We have a conf and classes directory, append to BBPATH
BBPATH .= ":${LAYERDIR}"

# We have a recipes directory, add to BBFILES
BBFILES += "${LAYERDIR}/recipes*/*/*.bb ${LAYERDIR}/recipes*/*/*.bbappend"

BBFILE_COLLECTIONS += "bsp-car"
BBFILE_PATTERN_bsp-car := "^${LAYERDIR}/"
BBFILE_PRIORITY_bsp-car = "6"

LAYERSERIES_COMPAT_bsp-car = "dunfell"
```

## meta-bsp-car/conf/machine/igep0030.conf
```bitbake
#@TYPE: Machine
#@NAME: IGEP machine
#@DESCRIPTION: Machine configuration for the IGEPv3.0 board

include conf/machine/include/tune-cortexa8.inc

GUI_MACHINE_CLASS = "smallscreen"

SERIAL_CONSOLE = "115200 ttyO2"

PREFERRED_PROVIDER_virtual/kernel = "linux-omap3"
PREFERRED_PROVIDER_virtual/bootloader = "u-boot-igepv3"
```

## meta-bsp-pda/conf/layer.conf
```bitbake
# We have a conf and classes directory, append to BBPATH
BBPATH .= ":${LAYERDIR}"

# We have a recipes directory, add to BBFILES
BBFILES += "${LAYERDIR}/recipes*/*/*.bb ${LAYERDIR}/recipes*/*/*.bbappend"

BBFILE_COLLECTIONS += "bsp-pda"
BBFILE_PATTERN_bsp-pda := "^${LAYERDIR}/"
BBFILE_PRIORITY_bsp-pda = "5"

LAYERSERIES_COMPAT_bsp-pda = "dunfell"
```

## meta-bsp-pxa250/conf/layer.conf
```bitbake
# We have a conf and classes directory, append to BBPATH
BBPATH .= ":${LAYERDIR}"

# We have a recipes directory, add to BBFILES
BBFILES += "${LAYERDIR}/recipes*/*/*.bb ${LAYERDIR}/recipes*/*/*.bbappend"

BBFILE_COLLECTIONS += "bsp-pxa250"
BBFILE_PATTERN_bsp-pxa250 := "^${LAYERDIR}/"
BBFILE_PRIORITY_bsp-pxa250 = "6"

LAYERSERIES_COMPAT_bsp-pxa250 = "dunfell"
```

## meta-bsp-sa1110/conf/layer.conf
```bitbake
# We have a conf and classes directory, append to BBPATH
BBPATH .= ":${LAYERDIR}"

# We have a recipes directory, add to BBFILES
BBFILES += "${LAYERDIR}/recipes*/*/*.bb ${LAYERDIR}/recipes*/*/*.bbappend"

BBFILE_COLLECTIONS += "bsp-sa1110"
BBFILE_PATTERN_bsp-sa1110 := "^${LAYERDIR}/"
BBFILE_PRIORITY_bsp-sa1110 = "6"

LAYERSERIES_COMPAT_bsp-sa1110 = "dunfell"
```

## meta-bsp-tv/conf/layer.conf
```bitbake
# We have a conf and classes directory, append to BBPATH
BBPATH .= ":${LAYERDIR}"

# We have a recipes directory, add to BBFILES
BBFILES += "${LAYERDIR}/recipes*/*/*.bb ${LAYERDIR}/recipes*/*/*.bbappend"

BBFILE_COLLECTIONS += "bsp-tv"
BBFILE_PATTERN_bsp-tv := "^${LAYERDIR}/"
BBFILE_PRIORITY_bsp-tv = "6"

LAYERSERIES_COMPAT_bsp-tv = "dunfell"
```

## meta-bsp-tv/conf/machine/board-tv.conf
```bitbake
#@TYPE: Machine
#@NAME: OMAP4430 PandaBoard, OMAP4460 Pandaboard ES, OMAP5432 IGEPv5, AM5728 BeagleBoard X15, AM5729 BeagleBone AI
#@DESCRIPTION: Machine configuration for the PandaBoard, Pandaboard ES, IGEPv5, BeagleBoard X15, BeagleBone AI

require conf/machine/include/soc-tv.inc

PREFERRED_PROVIDER_virtual/kernel = "linux-ti"
#PREFERRED_PROVIDER_virtual/egl = "sgx-libs"
#PREFERRED_PROVIDER_virtual/libgles = "sgx-libs"
#PREFERRED_PROVIDER_virtual/libgles2 = "sgx-libs"

PREFERRED_VERSION_linux-libc-headers = "4.19"
PREFERRED_VERSION_virtual/kernel = "4.19"

SERIAL_CONSOLE = "115200 ttyS2"
```

## meta-bsp-tv/conf/machine/include/soc-tv.inc
```bitbake
SOC_FAMILY = "soc-tv"
TARGET_ARCH = "arm"

require conf/machine/include/tune-cortexa9.inc

KERNEL_IMAGETYPE = "uImage"

UBOOT_ENTRYPOINT = "0x80008000"
UBOOT_LOADADDRESS = "0x80008000"

EXTRA_IMAGEDEPENDS += "u-boot"
```

## meta-bsp-tv/recipes-bsp/u-boot/files/igepv5/Kconfig
```kconfig
if TARGET_OMAP5_IGEP0050

config SYS_BOARD
	default "igep0050"

config SYS_VENDOR
	default "isee"

config SYS_CONFIG_NAME
	default "omap5_igep0050"

source "board/ti/common/Kconfig"

endif
```

## meta-mobiaqua/conf/distro/mobiaqua.conf
```bitbake
DISTRO = "mobiaqua"
DISTRO_NAME = "MobiAqua (Yocto MobiAqua)"
DISTRO_VERSION = "1.0"
DISTRO_CODENAME = "kirkstone"

MAINTAINER = "aquadran"

TARGET_VENDOR = "-mobiaqua"

LOCALCONF_VERSION = "1"

DISTRO_VERSION[vardepsexclude] = "DATE"
SDK_VERSION[vardepsexclude] = "DATE"

# Override these in mobiaqua based distros
MOBIAQUA_DEFAULT_DISTRO_FEATURES = "largefile alsa bluetooth wifi opengl"
MOBIAQUA_DEFAULT_EXTRA_RDEPENDS = ""
MOBIAQUA_DEFAULT_EXTRA_RRECOMMENDS = ""

DISTRO_FEATURES = "${MOBIAQUA_DEFAULT_DISTRO_FEATURES}"

SDK_NAME = "${DISTRO}-${TCLIBC}-${SDKMACHINE}-${IMAGE_BASENAME}-${TUNE_PKGARCH}-${MACHINE}"
SDKPATH = "/opt/${DISTRO}/${SDK_VERSION}"

DISTRO_EXTRA_RDEPENDS += " ${MOBIAQUA_DEFAULT_EXTRA_RDEPENDS}"
DISTRO_EXTRA_RRECOMMENDS += " ${MOBIAQUA_DEFAULT_EXTRA_RRECOMMENDS}"

TCLIBCAPPEND = ""

# Disable wide char support for ncurses as we don't include it in
# in the LIBC features below.
# Leave native enable to avoid build failures
ENABLE_WIDEC = "false"
ENABLE_WIDEC:class-native = "true"

ENABLE_BINARY_LOCALE_GENERATION = "0"

# Drop native language support. This removes the
# eglibc->bash->gettext->libc-posix-clang-wchar dependency.
USE_NLS = "no"

# enable mdev/busybox for init
INIT_MANAGER ?= "mdev-busybox"

TOOLCHAIN_TEST_TARGET = ""

IMAGE_FSTYPES = "tar.gz"
QB_DEFAULT_FSTYPE = "${IMAGE_FSTYPES}"

WARN_QA:remove = "patch-fuzz host-user-contaminated"

OELAYOUT_ABI = "12"

OPKGBUILDCMD:append = " -c -o 0 -g 0"

EXEWRAPPER_ENABLED = "False"
GTKDOC_ENABLED = "False"

PACKAGECONFIG:remove_pn-opkg-utils = "python"

PREFERRED_PROVIDER_virtual/egl = "mesa"
PREFERRED_PROVIDER_virtual/libgles = "mesa"
PREFERRED_PROVIDER_virtual/libgles2 = "mesa"
```

## meta-mobiaqua/conf/machine/beagle.conf
```bitbake
#@TYPE: Machine
#@NAME: AM5728 BeagleBoard X15, AM5729 BeagleBone AI
#@DESCRIPTION: Machine configuration for the BeagleBoard X15, BeagleBone AI

require conf/machine/include/arm/armv7a/tune-cortexa15.inc

KERNEL_IMAGETYPE = "uImage"

UBOOT_ENTRYPOINT = "0x80008000"
UBOOT_LOADADDRESS = "0x80008000"

PREFERRED_PROVIDER_virtual/kernel = "linux-ti"

PREFERRED_VERSION_linux-libc-headers = "6.1"
PREFERRED_VERSION_linux-ti ?= "6.1%"

SERIAL_CONSOLE = "115200 ttyS0"
```

## meta-mobiaqua/conf/machine/beagle64.conf
```bitbake
#@TYPE: Machine
#@NAME: BeagleBone AI-64 (A72)
#@DESCRIPTION: Machine configuration for the BeagleBone AI-64 board (A72 core)

require conf/machine/include/arm/arch-arm64.inc

KERNEL_IMAGETYPE = "uImage"

UBOOT_ENTRYPOINT = "0x80008000"
UBOOT_LOADADDRESS = "0x80008000"

PREFERRED_PROVIDER_virtual/kernel = "linux-ti"

PREFERRED_VERSION_linux-libc-headers = "6.1"
PREFERRED_VERSION_linux-ti ?= "6.1%"

SERIAL_CONSOLE = "115200 ttyS0"
```

## meta-mobiaqua/conf/machine/board-tv.conf
```bitbake
#@TYPE: Machine
#@NAME: OMAP4430 PandaBoard, OMAP4460 Pandaboard ES, OMAP5432 IGEPv5, AM5728 BeagleBoard X15, AM5729 BeagleBone AI
#@DESCRIPTION: Machine configuration for the PandaBoard, Pandaboard ES, IGEPv5, BeagleBoard X15, BeagleBone AI

require conf/machine/include/arm/armv7a/tune-cortexa9.inc

KERNEL_IMAGETYPE = "uImage"

UBOOT_ENTRYPOINT = "0x80008000"
UBOOT_LOADADDRESS = "0x80008000"

PREFERRED_PROVIDER_virtual/kernel = "linux-ti"

PREFERRED_VERSION_linux-libc-headers = "5.19"
PREFERRED_VERSION_virtual/kernel = "5.19"

SERIAL_CONSOLE = "115200 ttyS0"
```

## meta-mobiaqua/conf/machine/igep0030.conf
```bitbake
#@TYPE: Machine
#@NAME: IGEP machine
#@DESCRIPTION: Machine configuration for the IGEPv3.0 board

include conf/machine/include/arm/armv7a/tune-cortexa8.inc

PREFERRED_PROVIDER_virtual/kernel = "linux-ti"
PREFERRED_PROVIDER_virtual/bootloader = "x-loader-igep-mlo"

PREFERRED_VERSION_linux-libc-headers = "6.1"
PREFERRED_VERSION_linux-ti ?= "6.1%"

SERIAL_CONSOLE = "115200 ttyS2"
```

## meta-mobiaqua/conf/machine/panda.conf
```bitbake
#@TYPE: Machine
#@NAME: OMAP4430 PandaBoard, OMAP4460 Pandaboard ES
#@DESCRIPTION: Machine configuration for the PandaBoard, Pandaboard ES

require conf/machine/include/arm/armv7a/tune-cortexa9.inc

KERNEL_IMAGETYPE = "uImage"

UBOOT_ENTRYPOINT = "0x80008000"
UBOOT_LOADADDRESS = "0x80008000"

PREFERRED_PROVIDER_virtual/kernel = "linux-ti"

PREFERRED_VERSION_linux-libc-headers = "6.1"
PREFERRED_VERSION_linux-ti ?= "6.1%"

SERIAL_CONSOLE = "115200 ttyS2"
```

## meta-mobiaqua/conf/machine/pda-pxa250.conf
```bitbake
#@TYPE: Machine
#@NAME: PXA25x
#@DESCRIPTION: Machine configuration for the PDA with PXA250

require conf/machine/include/tune-xscale.inc

PREFERRED_PROVIDER_virtual/kernel = "linux-pda"

KERNEL_IMAGETYPE = "uImage"

UBOOT_ENTRYPOINT = "0xC0008000"
UBOOT_LOADADDRESS = "0xC0008000"

PCMCIA_MANAGER = "pcmciautils"

IMAGE_FSTYPES = "tar.bz2 jffs2"
```

## meta-mobiaqua/conf/machine/pda-sa1110.conf
```bitbake
#@TYPE: Machine
#@NAME: sa1100
#@DESCRIPTION: Machine configuration for the PDA with SA1100

require conf/machine/include/tune-strongarm1100.inc

PREFERRED_PROVIDER_virtual/kernel = "linux-pda"

PREFERRED_VERSION_linux-libc-headers = "4.9"

KERNEL_IMAGETYPE = "uImage"

UBOOT_ENTRYPOINT = "0xC0008000"
UBOOT_LOADADDRESS = "0xC0008000"

PCMCIA_MANAGER = "pcmciautils"

SERIAL_CONSOLE = "115200 ttySA0 vt100"

IMAGE_FSTYPES = "tar.bz2 jffs2"

EXTRA_IMAGECMD_jffs2 = "-p -l -e 0x40000 -U"
```

## meta-nuc/conf/layer.conf
```bitbake
# We have a conf and classes directory, add to BBPATH
BBPATH =. "${LAYERDIR}:"

# We have recipes-* directories, add to BBFILES
BBFILES += "${LAYERDIR}/recipes-*/*/*.bb \
            ${LAYERDIR}/recipes-*/*/*.bbappend"

BBFILE_COLLECTIONS += "nuc"
BBFILE_PATTERN_nuc = "^${LAYERDIR}/"
BBFILE_PRIORITY_nuc = "7"

LAYERSERIES_COMPAT_nuc = "kirkstone"

LICENSE_PATH += "${LAYERDIR}/licenses"

# This should only be incremented on significant changes that will
# cause compatibility issues with other layers
LAYERVERSION_yocto = "3"

LAYERDEPENDS_yocto = "core"

REQUIRED_POKY_BBLAYERS_CONF_VERSION = "2"
```

## meta-nuc/conf/machine/nuc.conf
```bitbake
#@TYPE: Machine
#@NAME: intel-skylake-64

#@DESCRIPTION: Machine configuration for 64 bit Intel Skylake CPU (and later) with MMX, SSE, SSE2, SSE3, SSE4.1, SSE4.2, AVX, and AVX2 instruction set support. Supports a moderately wide range of drivers that should boot and be usable on "typical" hardware.

require conf/machine/include/meta-intel.inc
require conf/machine/include/x86/x86-base.inc
require conf/machine/include/x86/tune-x86-64-v3.inc
require conf/machine/include/intel-common-pkgarch.inc

MACHINE_FEATURES += "efi"
MACHINE_FEATURES += "wifi"
MACHINE_FEATURES += "intel-ucode"

MACHINE_HWCODECS = "intel-media-driver"

PREFERRED_VERSION_linux-libc-headers = "6.1"
PREFERRED_VERSION_linux-intel ?= "6.1%"

COMPATIBLE_MACHINE:pn-dpdk = "intel-skylake-64"
COMPATIBLE_MACHINE:pn-dpdk-module = "intel-skylake-64"

SERIAL_CONSOLE = "115200 tty0"
SERIAL_CONSOLES = "115200;tty0"

APPEND += "rootwait console=tty0"

INSTALL_PKGS_RELEASE = "gmmlib intel-media-driver"

INSTALL_PKGS_DEBUG = "libva-intel-utils"

DEPENDS_DEBUG_TOOLS = "gdb-cross-x86_64"
```

## meta-null/conf/layer.conf
```bitbake
# We have a conf and classes directory, append to BBPATH
BBPATH .= ":${LAYERDIR}"

# We have a recipes directory, add to BBFILES
BBFILES += "${LAYERDIR}/*.bb"

BBFILE_COLLECTIONS += "null"
BBFILE_PATTERN_null := "^${LAYERDIR}/"
BBFILE_PRIORITY_null = "0"

LAYERSERIES_COMPAT_null = "dunfell"
```

## meta-softvm/conf/layer.conf
```bitbake
# We have a conf and classes directory, add to BBPATH
BBPATH =. "${LAYERDIR}:"

# We have recipes-* directories, add to BBFILES
BBFILES += "${LAYERDIR}/recipes-*/*/*.bb \
            ${LAYERDIR}/recipes-*/*/*.bbappend"

BBFILE_COLLECTIONS += "softvm"
BBFILE_PATTERN_softvm = "^${LAYERDIR}/"
BBFILE_PRIORITY_softvm = "6"

LAYERSERIES_COMPAT_softvm = "scarthgap"

LICENSE_PATH += "${LAYERDIR}/licenses"

# This should only be incremented on significant changes that will
# cause compatibility issues with other layers
LAYERVERSION_yocto = "3"

LAYERDEPENDS_yocto = "core"

REQUIRED_POKY_BBLAYERS_CONF_VERSION = "2"
```

## meta-softvm/conf/machine/emu-x86-64.conf
```bitbake
#@TYPE: Machine
#@NAME: EMU x86-64 machine
#@DESCRIPTION: Machine configuration for running an emulated x86-64 system

DEFAULTTUNE ?= "x86-64"
require conf/machine/include/x86/tune-i686.inc

KERNEL_IMAGETYPE = "vmlinux"
KERNEL_IMAGETYPES += "bzImage"

# Don't include kernels in standard images
RDEPENDS:${KERNEL_PACKAGE_NAME}-base = ""

PREFERRED_PROVIDER_virtual/kernel = "linux-x86"

PREFERRED_VERSION_linux-libc-headers = "6.6"
PREFERRED_VERSION_linux-intel ?= "6.6%"

SERIAL_CONSOLE = "115200 ttyS0"
SERIAL_CONSOLES = "115200;ttyS0"

APPEND += "rootwait console=ttyS0"
```

## meta-softvm/conf/machine/vm-arm64.conf
```bitbake
#@TYPE: Machine
#@NAME: VM arm64 machine
#@DESCRIPTION: Machine configuration for running an emulated arm64 system

require conf/machine/include/arm/arch-arm64.inc

KERNEL_IMAGETYPE = "bzImage"

# Don't include kernels in standard images
RDEPENDS:${KERNEL_PACKAGE_NAME}-base = ""

PREFERRED_PROVIDER_virtual/kernel = "linux-dummy"

PREFERRED_VERSION_linux-libc-headers = "6.6"
PREFERRED_VERSION_linux-intel ?= "6.6%"

SERIAL_CONSOLE = "115200 ttyS0"
SERIAL_CONSOLES = "115200;ttyS0"

APPEND += "rootwait console=ttyS0"
```

## meta-ti/conf/layer.conf
```bitbake
# We have a conf and classes directory, add to BBPATH
BBPATH =. "${LAYERDIR}:"

# We have recipes-* directories, add to BBFILES
BBFILES += "${LAYERDIR}/recipes-*/*/*.bb \
            ${LAYERDIR}/recipes-*/*/*.bbappend"

BBFILE_COLLECTIONS += "ti"
BBFILE_PATTERN_ti = "^${LAYERDIR}/"
BBFILE_PRIORITY_ti = "7"

LAYERSERIES_COMPAT_ti = "scarthgap"

LICENSE_PATH += "${LAYERDIR}/licenses"

# This should only be incremented on significant changes that will
# cause compatibility issues with other layers
LAYERVERSION_yocto = "3"

LAYERDEPENDS_yocto = "core"

REQUIRED_POKY_BBLAYERS_CONF_VERSION = "2"
```
